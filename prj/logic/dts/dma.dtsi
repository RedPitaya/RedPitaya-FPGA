/*
 * Disable DMA after boot, must be anabled by a DT overlay
 * TODO: it is probably not necessary to also disable each channel
 * axi_dma_2 is the only DMA of the logic project (rprx@2, the LA capture)
 */

&axi_dma_2 {
	status = "disabled";
};

/*
 * QSPI Flash specific code
 */

&qspi {
      xlnx,fb-clk = <0x1>;
      xlnx,qspi-mode = <0x0>;

      flash@0 {
            compatible = "jedec,spi-nor";
            reg = <0>;  /* CS0 */
            spi-tx-bus-width = <1>;
            spi-rx-bus-width = <1>;
            spi-max-frequency = <50000000>; /* 50 MHz */

            partition@qspi-fsbl-uboot {
                  label = "qspi-fsbl-uboot";
                  reg = <0x0 0x800000>;
            };
      };
};

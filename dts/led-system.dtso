/dts-v1/;
/plugin/;

/ {

        fragment@0 {
                target-path = "/";

                __overlay__ {
                led-system {
                                compatible = "gpio-leds";

                                led-8-yellow {
                                        default-state = "off";
                                        gpios = <0x0a 0x00 0x00>;
                                        label = "led8";
                                        linux,default-trigger = "mmc0";
                                };

                                led-9-red {
                                        default-state = "off";
                                        gpios = <0x0a 0x07 0x00>;
                                        label = "led9";
                                        linux,default-trigger = "heartbeat";
                                };
                        };
                };
        };
};
